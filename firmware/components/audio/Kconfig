## firmware/components/audio/Kconfig
```kconfig
menu "aibot audio"

    config AIBOT_I2S_BCLK_GPIO
        int "MAX98357A BCLK GPIO"
        default 4

    config AIBOT_I2S_LRC_GPIO
        int "MAX98357A LRC (word select) GPIO"
        default 5

    config AIBOT_I2S_DIN_GPIO
        int "MAX98357A DIN GPIO"
        default 6

    config AIBOT_AUDIO_VOLUME
        int "Volume at boot (%)"
        range 0 100
        default 50

    config AIBOT_MIC_SCK_GPIO
        int "INMP441 SCK (bit clock) GPIO"
        default 15

    config AIBOT_MIC_WS_GPIO
        int "INMP441 WS (word select) GPIO"
        default 16

    config AIBOT_MIC_SD_GPIO
        int "INMP441 SD (data) GPIO"
        default 17

    config AIBOT_MIC_GAIN_DB
        int "Microphone gain at boot (dB)"
        range 0 40
        default 18

endmenu
```

## firmware/components/display/Kconfig
```kconfig
menu "aibot display"

    config AIBOT_LCD_MOSI_GPIO
        int "LCD DIN (MOSI) GPIO"
        default 11

    config AIBOT_LCD_SCLK_GPIO
        int "LCD CLK GPIO"
        default 12

    config AIBOT_LCD_CS_GPIO
        int "LCD CS GPIO"
        default 10

    config AIBOT_LCD_DC_GPIO
        int "LCD DC GPIO"
        default 13

    config AIBOT_LCD_RST_GPIO
        int "LCD RST GPIO"
        default 14

    config AIBOT_LCD_BL_GPIO
        int "LCD BL (backlight) GPIO"
        default 21

    config AIBOT_LCD_SPI_MHZ
        int "SPI clock (MHz)"
        range 1 80
        default 40
        help
            40 MHz is safe over jumper wires. 80 MHz needs short, clean wiring.

    config AIBOT_LCD_INVERT
        bool "Invert colors"
        default y

    config AIBOT_LCD_MIRROR_X
        bool "Mirror X"
        default y

    config AIBOT_LCD_MIRROR_Y
        bool "Mirror Y"
        default n

    config AIBOT_LCD_SWAP_RB
        bool "Swap red and blue (panel is BGR)"
        default y

    config AIBOT_LCD_BRIGHTNESS
        int "Backlight brightness at boot (%)"
        range 0 100
        default 80

endmenu
```

## firmware/components/motion/Kconfig
```kconfig
menu "aibot motion"

    config AIBOT_I2C_SDA_GPIO
        int "I2C SDA GPIO (to PCA9685)"
        default 8

    config AIBOT_I2C_SCL_GPIO
        int "I2C SCL GPIO (to PCA9685)"
        default 9

    config AIBOT_PCA9685_ADDR
        hex "PCA9685 I2C address"
        default 0x40

endmenu
```
